## buildroot.octonet/Config.in
```kconfig
source "$BR2_EXTERNAL_OCTONET_PATH/package/octoserve/Config.in"
source "$BR2_EXTERNAL_OCTONET_PATH/package/octoscan/Config.in"
source "$BR2_EXTERNAL_OCTONET_PATH/package/lunajson/Config.in"
source "$BR2_EXTERNAL_OCTONET_PATH/package/dddvb/Config.in"
source "$BR2_EXTERNAL_OCTONET_PATH/package/dvb-apps-tbs/Config.in"
source "$BR2_EXTERNAL_OCTONET_PATH/package/minisatip/Config.in"
source "$BR2_EXTERNAL_OCTONET_PATH/package/python2/Config.in"
source "$BR2_EXTERNAL_OCTONET_PATH/package/octonet-hwfixup/Config.in"
```

## buildroot.octonet/configs/digitaldevices_octonet_defconfig
```kconfig
BR2_arm=y
BR2_TOOLCHAIN_EXTERNAL=y
BR2_TOOLCHAIN_EXTERNAL_CUSTOM=y
BR2_TOOLCHAIN_EXTERNAL_PATH="$(TOPDIR)/output-octonet-tc/host/usr"
BR2_TOOLCHAIN_EXTERNAL_HEADERS_6_12=y
BR2_TOOLCHAIN_EXTERNAL_LOCALE=y
# BR2_TOOLCHAIN_EXTERNAL_HAS_THREADS_DEBUG is not set
BR2_TOOLCHAIN_EXTERNAL_CXX=y
BR2_CCACHE=y
BR2_TARGET_GENERIC_HOSTNAME="octonet"
BR2_TARGET_GENERIC_ISSUE="Welcome to octonet"
BR2_TARGET_GENERIC_ROOT_PASSWD="octonet"
BR2_TARGET_TZ_INFO=y
BR2_ROOTFS_OVERLAY="$(BR2_EXTERNAL)/board/digitaldevices/octonet/overlay"
BR2_ROOTFS_POST_BUILD_SCRIPT="$(BR2_EXTERNAL)/board/digitaldevices/octonet/post-build.sh"
BR2_LINUX_KERNEL=y
BR2_LINUX_KERNEL_CUSTOM_VERSION=y
BR2_LINUX_KERNEL_CUSTOM_VERSION_VALUE="6.12.91"
BR2_LINUX_KERNEL_PATCH="$(BR2_EXTERNAL)/board/digitaldevices/octonet/patches/linux/"
BR2_LINUX_KERNEL_USE_CUSTOM_CONFIG=y
BR2_LINUX_KERNEL_CUSTOM_CONFIG_FILE="$(BR2_EXTERNAL)/board/digitaldevices/octonet/linux.config"
BR2_LINUX_KERNEL_DTS_SUPPORT=y
BR2_LINUX_KERNEL_INTREE_DTS_NAME="microchip/at91-octonet"
BR2_LINUX_KERNEL_CUSTOM_DTS_DIR="$(BR2_EXTERNAL)/board/digitaldevices/octonet/dts"
BR2_LINUX_KERNEL_INSTALL_TARGET=y
BR2_PACKAGE_BUSYBOX_CONFIG="$(BR2_EXTERNAL)/board/digitaldevices/octonet/busybox.config"
BR2_PACKAGE_BUSYBOX_SHOW_OTHERS=y
BR2_PACKAGE_BZIP2=y
BR2_PACKAGE_GETTEXT=y
BR2_PACKAGE_MTD=y
# BR2_PACKAGE_MTD_FLASH_LOCK is not set
# BR2_PACKAGE_MTD_FLASH_UNLOCK is not set
# BR2_PACKAGE_MTD_MTD_DEBUG is not set
# BR2_PACKAGE_MTD_NANDDUMP is not set
# BR2_PACKAGE_MTD_NANDTEST is not set
BR2_PACKAGE_ACPID=y
BR2_PACKAGE_I2C_TOOLS=y
BR2_PACKAGE_UBOOT_TOOLS=y
BR2_PACKAGE_UBOOT_TOOLS_FIT_SUPPORT=y
BR2_PACKAGE_LUA=y
BR2_PACKAGE_LUA_5_1=y
BR2_PACKAGE_LUA_READLINE=y
BR2_PACKAGE_LSQLITE3=y
BR2_PACKAGE_LUAJSON=y
BR2_PACKAGE_LUAOSSL=y
BR2_PACKAGE_LUASOCKET=y
BR2_PACKAGE_LUASQL_SQLITE3=y
BR2_PACKAGE_LUASYSLOG=y
BR2_PACKAGE_GNUTLS=y
BR2_PACKAGE_LIBGCRYPT=y
BR2_PACKAGE_LIBFUSE3=y
BR2_PACKAGE_LIBNFS=y
BR2_PACKAGE_EXPAT=y
BR2_PACKAGE_GLIB_NETWORKING=y
BR2_PACKAGE_GUPNP_AV=y
BR2_PACKAGE_LIBBACKTRACE=y
BR2_PACKAGE_LIBEV=y
BR2_PACKAGE_LIBEVENT=y
BR2_PACKAGE_PCRE2_32=y
BR2_PACKAGE_PCRE2_JIT=y
BR2_PACKAGE_DROPBEAR=y
BR2_PACKAGE_ETHTOOL=y
BR2_PACKAGE_IPTABLES=y
BR2_PACKAGE_IPTABLES_NFTABLES=y
BR2_PACKAGE_ODHCP6C=y
BR2_PACKAGE_RPCBIND=y
BR2_PACKAGE_RSYNC=y
BR2_PACKAGE_TCPDUMP=y
BR2_PACKAGE_WGET=y
BR2_PACKAGE_BASH=y
BR2_PACKAGE_XXHASH=y
BR2_PACKAGE_HTOP=y
BR2_PACKAGE_KMOD=y
BR2_PACKAGE_KMOD_TOOLS=y
BR2_PACKAGE_UTIL_LINUX_LIBMOUNT=y
BR2_TARGET_ROOTFS_TAR_BZIP2=y
BR2_PACKAGE_HOST_UBOOT_TOOLS=y
BR2_PACKAGE_OCTOSERVE=y
BR2_PACKAGE_OCTOSCAN=y
BR2_PACKAGE_LUNAJSON=y
BR2_PACKAGE_DVB_APPS_TBS=y
BR2_PACKAGE_OCTONET_HWFIXUP=y
```

## buildroot.octonet/configs/digitaldevices_octonet_init_defconfig
```kconfig
BR2_arm=y
BR2_TOOLCHAIN_EXTERNAL=y
BR2_TOOLCHAIN_EXTERNAL_CUSTOM=y
BR2_TOOLCHAIN_EXTERNAL_PATH="$(TOPDIR)/output-octonet-tc/host/usr"
BR2_TOOLCHAIN_EXTERNAL_HEADERS_6_12=y
BR2_TOOLCHAIN_EXTERNAL_LOCALE=y
# BR2_TOOLCHAIN_EXTERNAL_HAS_THREADS_DEBUG is not set
BR2_TOOLCHAIN_EXTERNAL_CXX=y
BR2_CCACHE=y
BR2_PACKAGE_OVERRIDE_FILE="$(BR2_EXTERNAL)/board/digitaldevices/octonet/local.mk"
BR2_TARGET_GENERIC_HOSTNAME="octonet"
BR2_TARGET_GENERIC_ISSUE="Welcome to Octonet"
BR2_TARGET_GENERIC_ROOT_PASSWD="octonet"
BR2_ROOTFS_OVERLAY="$(BR2_EXTERNAL)/board/digitaldevices/octonet/overlay.init"
BR2_LINUX_KERNEL=y
BR2_LINUX_KERNEL_CUSTOM_VERSION=y
BR2_LINUX_KERNEL_CUSTOM_VERSION_VALUE="6.12.91"
BR2_LINUX_KERNEL_PATCH="$(BR2_EXTERNAL)/board/digitaldevices/octonet/patches/linux"
BR2_LINUX_KERNEL_USE_CUSTOM_CONFIG=y
BR2_LINUX_KERNEL_CUSTOM_CONFIG_FILE="$(BR2_EXTERNAL)/board/digitaldevices/octonet/linux_init.config"
BR2_LINUX_KERNEL_APPENDED_ZIMAGE=y
BR2_LINUX_KERNEL_INTREE_DTS_NAME="at91-octonet"
BR2_LINUX_KERNEL_CUSTOM_DTS_PATH="$(BR2_EXTERNAL)/board/digitaldevices/octonet/at91-octonet.dts"
BR2_PACKAGE_BUSYBOX_CONFIG="$(BR2_EXTERNAL)/board/digitaldevices/octonet/busybox.config"
BR2_PACKAGE_BUSYBOX_SHOW_OTHERS=y
BR2_PACKAGE_MTD=y
BR2_PACKAGE_KMOD=y
BR2_TARGET_ROOTFS_CPIO_XZ=y
BR2_TARGET_ROOTFS_CPIO_UIMAGE=y
BR2_TARGET_ROOTFS_INITRAMFS=y
# BR2_TARGET_ROOTFS_TAR is not set
BR2_PACKAGE_HOST_DTC=y
# BR2_PACKAGE_DDDVB is not set
```

## buildroot.octonet/configs/digitaldevices_octonet_tc_defconfig
```kconfig
BR2_arm=y
BR2_TOOLCHAIN_BUILDROOT_UCLIBC=y
BR2_TOOLCHAIN_BUILDROOT_LOCALE=y
BR2_GCC_VERSION_14_X=y
BR2_TOOLCHAIN_BUILDROOT_CXX=y
# BR2_TARGET_ENABLE_ROOT_LOGIN is not set
# BR2_TARGET_GENERIC_GETTY is not set
# BR2_TARGET_GENERIC_REMOUNT_ROOTFS_RW is not set
# BR2_ENABLE_LOCALE_PURGE is not set
# BR2_TARGET_ROOTFS_TAR is not set
# BR2_PACKAGE_DDDVB is not set
```

## buildroot.octonet/package/dvb-apps-tbs/Config.in
```kconfig
config BR2_PACKAGE_DVB_APPS_TBS
    bool "dvb-apps-tbs"
    help
      TBS variant of dvb-apps.
```

## buildroot.octonet/package/minisatip/Config.in
```kconfig
config BR2_PACKAGE_MINISATIP
	bool "minisatip"
	select BR2_PACKAGE_LIBBACKTRACE  # <--- Das zwingt Buildroot, libbacktrace zu bauen
	select BR2_PACKAGE_OPENSSL       # <--- Das sorgt für openssl
	help
	  Minisatip is a multi-threaded SAT>IP server.
```

## buildroot.octonet/package/octonet-hwfixup/Config.in
```kconfig
config BR2_PACKAGE_OCTONET_HWFIXUP
	bool "octonet-hwfixup"
	depends on BR2_LINUX_KERNEL
	help
	  Late low-level hardware fixup for Octonet AT91SAM9G45 boards.

comment "octonet-hw-fix needs a Linux kernel to be built"
	depends on !BR2_LINUX_KERNEL
```

## buildroot.octonet/package/octoserve/Config.in
```kconfig
config BR2_PACKAGE_OCTOSERVE
       bool "octoserve"
       default n
       help
              http://www.digitaldevices.de
```

## buildroot.octonet/package/oscam/Config.in
```kconfig
config BR2_PACKAGE_OSCAM
	bool "oscam"
	select BR2_PACKAGE_OPENSSL
	select BR2_PACKAGE_LIBUSB if BR2_PACKAGE_HAS_UDEV
	help
	  OSCam is an Open Source Conditional Access Module software,
	  a versatile cardserver and softcam utility.

	  https://git.streamboard.tv/common/oscam
```

## buildroot.octonet/package/python2-gobject/Config.in
```kconfig
config BR2_PACKAGE_PYTHON2_GOBJECT
    bool "python2-gobject"
    depends on BR2_PACKAGE_PYTHON2
    select BR2_PACKAGE_LIBGLIB2
    help
      Python bindings for the GLib/GObject library.
```

## buildroot.octonet/package/python2/Config.in.host
```kconfig
config BR2_PACKAGE_HOST_PYTHON2
	bool "host python2"
	help
	  The python language interpreter. Host package.

	  http://www.python.org/

if BR2_PACKAGE_HOST_PYTHON2

config BR2_PACKAGE_HOST_PYTHON2_SSL
	bool "ssl"
	select BR2_PACKAGE_HOST_OPENSSL
	help
	  _ssl module for host Python.

endif
```

## buildroot.octonet/package/runit/Config.in
```kconfig
config BR2_PACKAGE_RUNIT
	bool "runit"
	depends on BR2_USE_MMU # fork()
	help
	  runit is a cross-platform Unix init scheme with service 
	  supervision.

	  http://smarden.org
```
